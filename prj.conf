## CMakeLists.txt
```
cmake_minimum_required(VERSION 3.20.0)
set(DTC_OVERLAY_FILE "${CMAKE_CURRENT_SOURCE_DIR}/dongle.overlay" CACHE STRING "")
find_package(Zephyr REQUIRED HINTS $ENV{ZEPHYR_BASE})

project(Receiver)

target_sources(app PRIVATE src/main.c)
```

## prj.conf
```kconfig
# Release build: USB HID only, no UART or CDC debug logging.
CONFIG_LOG=n
CONFIG_CONSOLE=n
CONFIG_BOOT_BANNER=n
CONFIG_NCS_BOOT_BANNER=n
CONFIG_PRINTK=n
CONFIG_LOG_BACKEND_UART=n
CONFIG_LOG_BACKEND_RTT=n
CONFIG_UART_CONSOLE=n
CONFIG_SERIAL=n

# ESB radio link
CONFIG_ESB=y
CONFIG_CLOCK_CONTROL=y
CONFIG_ESB_CLOCK_INIT=y
CONFIG_ESB_RADIO_IRQ_PRIORITY=0
CONFIG_ESB_PIPE_COUNT=8

# Platform
CONFIG_GPIO=y
CONFIG_PINCTRL=y
CONFIG_FLASH=y
CONFIG_SYSTEM_CLOCK_WAIT_FOR_STABILITY=y
CONFIG_MAIN_STACK_SIZE=2048
CONFIG_BUILD_OUTPUT_UF2=n

# Initialize the HID device from main after registering its report descriptor.
CONFIG_BOARD_SERIAL_BACKEND_CDC_ACM=n
CONFIG_USB_CDC_ACM=n

# Legacy USB HID device stack without a debug serial interface.
CONFIG_USB_DEVICE_STACK=y
CONFIG_USB_DEVICE_INITIALIZE_AT_BOOT=n
CONFIG_USB_COMPOSITE_DEVICE=n
CONFIG_USB_DEVICE_HID=y
CONFIG_ENABLE_HID_INT_OUT_EP=y
CONFIG_USB_DEVICE_VID=0x1B4F
CONFIG_USB_DEVICE_PID=0x0001
CONFIG_USB_DEVICE_PRODUCT="A4TECH Receiver"
CONFIG_USB_DEVICE_MANUFACTURER="Monard"
CONFIG_USB_HID_POLL_INTERVAL_MS=1
CONFIG_USB_HID_BOOT_PROTOCOL=y
CONFIG_USB_DEVICE_OS_DESC=y
```

## prj_diag.conf
```kconfig
# DIAGNOSTIC build (temporary, OTA reverse-path investigation):
# release prj.conf plus logging over the dongle's USB CDC console.
CONFIG_LOG=y
CONFIG_CONSOLE=y
CONFIG_BOOT_BANNER=y
CONFIG_PRINTK=y
CONFIG_LOG_BACKEND_UART=y
CONFIG_UART_CONSOLE=y
CONFIG_SERIAL=y
CONFIG_LOG_BACKEND_RTT=n
CONFIG_LOG_MODE_DEFERRED=y

# ESB radio link
CONFIG_ESB=y
CONFIG_CLOCK_CONTROL=y
CONFIG_ESB_CLOCK_INIT=y
CONFIG_ESB_RADIO_IRQ_PRIORITY=0
CONFIG_ESB_PIPE_COUNT=8

# Platform
CONFIG_GPIO=y
CONFIG_PINCTRL=y
CONFIG_FLASH=y
CONFIG_SYSTEM_CLOCK_WAIT_FOR_STABILITY=y
CONFIG_MAIN_STACK_SIZE=2048
CONFIG_BUILD_OUTPUT_UF2=n

# Initialize the HID device from main after registering its report descriptor.
CONFIG_BOARD_SERIAL_BACKEND_CDC_ACM=n
CONFIG_USB_CDC_ACM=y

# Legacy USB HID device stack; CDC ACM console alongside HID.
CONFIG_USB_DEVICE_STACK=y
CONFIG_USB_DEVICE_INITIALIZE_AT_BOOT=n
CONFIG_USB_COMPOSITE_DEVICE=y
CONFIG_USB_DEVICE_HID=y
CONFIG_ENABLE_HID_INT_OUT_EP=y
CONFIG_USB_DEVICE_VID=0x1B4F
CONFIG_USB_DEVICE_PID=0x0001
CONFIG_USB_DEVICE_PRODUCT="A4TECH Receiver"
CONFIG_USB_DEVICE_MANUFACTURER="Monard"

# Diag: the receiver main loop never blocks, so it would starve the log
# and status threads at default priorities. Keep logging runnable.
CONFIG_MAIN_THREAD_PRIORITY=10
CONFIG_LOG_PROCESS_THREAD_PRIORITY=9
```

## dongle.overlay
```dts
zephyr_udc0: &usbd {
    status = "okay";
};
```

## src/main(Receiver).c
```c
/*
 * Copyright (c) 2024 Monard2033
 * SPDX-License-License-Identifier: Apache-2.0
 */

 #include <zephyr/kernel.h>
 #include <zephyr/usb/usb_device.h>
 #include <zephyr/usb/class/usb_hid.h>
 #include <zephyr/logging/log.h>
 #include <zephyr/device.h>
 #include <esb.h>
 #include <string.h>
 #define REPORT_ID               1
 LOG_MODULE_REGISTER(RECEIVER, LOG_LEVEL_INF);
 
 /* --- ESB Configuration --- */
 static struct esb_payload rx_payload;
 static struct esb_config esb_config = ESB_DEFAULT_CONFIG;
 
 /* --- USB HID Configuration --- */
 static const struct device *hid_dev;
 static K_SEM_DEFINE(usb_configured_sem, 0, 1);
 static volatile bool configured = false; /* Set by default for testing */
 
 /* Key Configuration */
 #define KEY_CTRL_CODE_MIN 224
 #define KEY_CTRL_CODE_MAX 231
 #define KEY_CODE_MIN      0
 #define KEY_CODE_MAX      101
 #define KEY_PRESS_MAX     6
 #define INPUT_REPORT_KEYS_MAX_LEN (1 + 1 + KEY_PRESS_MAX)
 
 BUILD_ASSERT((KEY_CTRL_CODE_MAX - KEY_CTRL_CODE_MIN) + 1 == 8);
 
 /* HID Report Descriptor for a standard keyboard */
 static const uint8_t hid_report_desc[] = {
     0x05, 0x01, 0x09, 0x06, 0xA1, 0x01, 0x75, 0x01,
     0x95, 0x08, 0x05, 0x07, 0x19, 0xE0, 0x29, 0xE7,
     0x15, 0x00, 0x25, 0x01, 0x81, 0x02, 0x95, 0x01,
     0x75, 0x08, 0x81, 0x01, 0x95, 0x06, 0x75, 0x08,
     0x15, 0x00, 0x25, 0x65, 0x05, 0x07, 0x19, 0x00,
     0x29, 0x65, 0x81, 0x00, 0xC0
 };

 struct usb_desc_strings {
    const uint8_t *product;
};
 
//  /* Keyboard State */
//  static struct keyboard_state {
//      uint8_t ctrl_keys_state;
//      uint8_t keys_state[KEY_PRESS_MAX];
//  } hid_keyboard_state;

static void int_in_ready_cb(const struct device *hid_dev)
{
    LOG_INF("IN endpoint ready to send data. Sending empty report.");
    static uint8_t report[2] = {REPORT_ID, 0};
    if (hid_int_ep_write(hid_dev, report, sizeof(report), NULL)) {
        LOG_ERR("Failed to submit report");
    } else {
        report[1]++;
    }
}

 // Define your HID operations structure
static const struct hid_ops my_hid_ops = {
    .int_in_ready = int_in_ready_cb,
};
 
 static void usb_status_cb(enum usb_dc_status_code status, const uint8_t *param)
 {
     ARG_UNUSED(param);
     LOG_DBG("USB status callback: status=%d", status);
     switch (status) {
     case USB_DC_CONFIGURED:
         LOG_INF("USB_DC_CONFIGURED received, setting configured = true");
         configured = true;
         k_sem_give(&usb_configured_sem);
         break;
     default:
         LOG_DBG("Unknown USB status code: %d", status);
         break;
     }
 }
 
 void receiver_esb_event_handler(struct esb_evt const *event)
 {
     switch (event->evt_id) {
     case ESB_EVENT_TX_SUCCESS:
         LOG_INF("TX success (unexpected in PRX mode)");
         break;
     case ESB_EVENT_TX_FAILED:
         LOG_ERR("TX failed (unexpected in PRX mode)");
         break;
     case ESB_EVENT_RX_RECEIVED:
        if (esb_read_rx_payload(&rx_payload) == 0) {
            LOG_INF("Received Payload (length: %d bytes)", rx_payload.length);
            LOG_INF("Data: D+ = %d, D- = %d", rx_payload.data[0], rx_payload.data[1]);
            LOG_HEXDUMP_INF(rx_payload.data, rx_payload.length, "Raw Payload");
            if (rx_payload.length == 8) {
                LOG_INF("Processing HID report (8 bytes)");
                if (hid_dev && configured) {
                    uint8_t hid_report[8] = {0};
                    memcpy(hid_report, rx_payload.data, 8);
                    hid_int_ep_write(hid_dev, hid_report, 8, NULL);
            } else if (rx_payload.length == 2) {
                LOG_INF("Received test payload (2 bytes): D+ = %d, D- = %d", rx_payload.data[0], rx_payload.data[1]);
            } else {
                LOG_WRN("Unexpected payload length: %d", rx_payload.length);
                LOG_HEXDUMP_INF(rx_payload.data, rx_payload.length, "Unexpected Payload");
            }
        } else {
            LOG_ERR("Failed to read RX payload");
        }
        break;
        }
    }
}
 
 int main(void)
 {
     int err;
     LOG_INF("Starting 2.4GHz HID Keyboard sample");
     /* Initialize USB HID */
     hid_dev = device_get_binding("HID_0");
     LOG_INF("USB device found and ready.");
     
     usb_hid_register_device(hid_dev, hid_report_desc, sizeof(hid_report_desc), &my_hid_ops);
     LOG_INF("HID registered.");

     err = usb_hid_init(hid_dev);
     if (err) {
         LOG_ERR("Failed to init USB HID, err %d", err);
         return 0;
     }
     LOG_INF("HID initialized.");

 
     LOG_INF("Attempting to enable USB...");
     if (IS_ENABLED(CONFIG_USB_DEVICE_STACK)) {
         usb_dc_set_status_callback(&usb_status_cb);
         err = usb_enable(&usb_status_cb);
         if (err) {
             LOG_ERR("Failed to enable USB, err %d", err);
             return 0;
         }
         LOG_INF("USB enabled successfully.");
     }

     /* Initialize ESB */
     esb_config.protocol = ESB_PROTOCOL_ESB_DPL;
     esb_config.mode = ESB_MODE_PRX;
     esb_config.bitrate = ESB_BITRATE_2MBPS;
     esb_config.payload_length = 8;
     esb_config.retransmit_count = 3;
     esb_config.event_handler = receiver_esb_event_handler;
 
     err = esb_init(&esb_config);
     if (err) {
         LOG_ERR("ESB initialization failed, err %d", err);
         return 0;
     }
 
     uint8_t base_addr_0[4] = {0xAB, 0x12, 0xCD, 0x34};
     err = esb_set_base_address_0(base_addr_0);
     if (err) {
         LOG_ERR("Failed to set base address 0, err %d", err);
         return 0;
     }
 
     uint8_t prefixes[8] = {0xA1, 0xA2, 0xA3, 0xA4, 0xA5, 0xA6, 0xA7, 0xA8};
     err = esb_set_prefixes(prefixes, 8);
     if (err) {
         LOG_ERR("Failed to set prefixes, err %d", err);
         return 0;
     }
 
     err = esb_start_rx();
     if (err) {
         LOG_ERR("Failed to start ESB RX, err %d", err);
         return 0;
     }
     LOG_INF("ESB Receiver initialized and started successfully.");

     while (1) {
         k_sleep(K_SECONDS(1));
     }
     return 0;
 }
```
