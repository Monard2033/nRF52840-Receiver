## ReceiverBuild/Kconfig/boards/Kconfig.nrf52840dongle
```kconfig
# Load board Kconfig descriptions.
osource "C:/ncs/v3.0.2/zephyr/boards/nordic/nrf52840dongle/Kconfig.nrf52840dongle"
```

## ReceiverBuild/Receiver/Kconfig/arch/Kconfig
```kconfig
# Load Zephyr Arch Kconfig descriptions.
osource "C:/ncs/v3.0.2/zephyr/arch/x86/Kconfig"
osource "C:/ncs/v3.0.2/zephyr/arch/xtensa/Kconfig"
osource "C:/ncs/v3.0.2/zephyr/arch/sparc/Kconfig"
osource "C:/ncs/v3.0.2/zephyr/arch/riscv/Kconfig"
osource "C:/ncs/v3.0.2/zephyr/arch/posix/Kconfig"
osource "C:/ncs/v3.0.2/zephyr/arch/nios2/Kconfig"
osource "C:/ncs/v3.0.2/zephyr/arch/mips/Kconfig"
osource "C:/ncs/v3.0.2/zephyr/arch/arm64/Kconfig"
osource "C:/ncs/v3.0.2/zephyr/arch/arm/Kconfig"
osource "C:/ncs/v3.0.2/zephyr/arch/arc/Kconfig"
```

## ReceiverBuild/Receiver/Kconfig/boards/Kconfig.defconfig
```kconfig
# Load Zephyr board defconfig descriptions.
osource "C:/ncs/v3.0.2/zephyr/boards/nordic/nrf52840dongle/Kconfig.defconfig"
```
